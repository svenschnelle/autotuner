system.reset
system.cpu stm32f407vg
system.config.DEBUGPORTTYPE SWD
system.up
flash.reset
flash.Create 1. 0x08000000--0x08003FFF TARGET Byte 0.
flash.Create 1. 0x08004000--0x08007FFF TARGET Byte 1.
flash.Create 1. 0x08008000--0x0800BFFF TARGET Byte 2.
flash.Create 1. 0x0800C000--0x0800FFFF TARGET Byte 3.
flash.Create 1. 0x08010000--0x0801FFFF TARGET Byte 4.
flash.Create 1. 0x08020000--0x0803FFFF TARGET Byte 5.
flash.Create 1. 0x08040000--0x0805FFFF TARGET Byte 6.
flash.Create 1. 0x08060000--0x0807FFFF TARGET Byte 7.
flash.Create 1. 0x08080000--0x0809FFFF TARGET Byte 8.
flash.Create 1. 0x080A0000--0x080BFFFF TARGET Byte 9.
flash.Create 1. 0x080C0000--0x080DFFFF TARGET Byte 10.
flash.Create 1. 0x080E0000--0x080FFFFF TARGET Byte 11.
flash.target 0x20000000 0x20001000 0x4000 ~~/demo/arm/flash/byte/stm32f400.bin
flash.reprogram.all /erase
;data.load.auto *
data.load.elf tune.elf
flash.reprogram.off
system.down
system.up
break.reset
;win.reset
term.heapinfo 0x0 0x20000 0x30000 0x20000
term.method armswi
term.mode string
;term.gate
g
